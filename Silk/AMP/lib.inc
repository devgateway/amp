[ ] // Our library
[-] void login(string user, string pass)
	[ ] AMPHome1.SetActive( )
	[ ] AMPHome1.SerLogIn.SetText(user)
	[ ] AMPHome1.Assword.SetText(pass)
	[ ] AMPHome1.SignIn.Click ()
	[ ] 
[-] void calendarCheckAll()
	[ ] 
	[ ] 
[ ] //Check Calendar Event Types
[-] void calendarTest2Preconditions()
	[ ] login("atl@amp.org", "atl")
	[ ] startConditions()
	[ ] //AMPDesktopLinks.TopMenu.Calendar.Click()
	[ ] calendarCheckEventTypes()
	[ ] calendarCheckDonors()
	[ ] 
	[ ] AMPCalendar.ShowPublicEvents.Check()
	[ ] AMPCalendar.Show.Click()
	[ ] 
	[-] AMPCalendar.NewEventForTest.VerifyProperties ({...})
		[ ] ""
		[-] {...}
			[ ] {"Exists",               TRUE}
			[ ] {"Text",                 "New Event for Test"}
	[ ] //end preconditions
	[ ] 
[-] void startConditions()
	[-] if (AMPDesktopLinks.BilateralFundedActivities.Exists())
		[ ] AMPDesktopLinks.BilateralFundedActivities.Click ()
	[-] //if (AMPMyDesktop.ProjectManagementPlatformP.CALENDAR.Exists())
		[ ] //AMPMyDesktop.ProjectManagementPlatformP.CALENDAR.Click ()
	[-] if (AMPMyDesktop.ProjectManagementPlatformP.REPORTS.Exists())
		[ ] AMPMyDesktop.ProjectManagementPlatformP.REPORTS.Click ()
	[-] if (AMPDesktopLinks.TopMenu.Calendar.Exists())
		[ ] AMPDesktopLinks.TopMenu.Calendar.Click()
[-] void calendarCheckEventTypes()
	[ ] // to be implemented
[-] void calendarCheckDonors()
	[ ] // to be implemented
